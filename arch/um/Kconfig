## arch/um/Kconfig
```kconfig
# SPDX-License-Identifier: GPL-2.0

menu "UML-specific options"

config UML
	bool
	default y
	select ARCH_DISABLE_KASAN_INLINE if STATIC_LINK
	select ARCH_NEEDS_DEFER_KASAN if STATIC_LINK
	select ARCH_WANTS_DYNAMIC_TASK_STRUCT
	select ARCH_HAS_CACHE_LINE_SIZE
	select ARCH_HAS_CPU_FINALIZE_INIT
	select ARCH_HAS_FORTIFY_SOURCE
	# Clang 20 & 21 miscompute __builtin_object_size() under -fprofile-arcs
	# on 32-bit, causing spurious compile-time errors in check_copy_size().
	select ARCH_HAS_GCOV_PROFILE_ALL if !(!64BIT && CLANG_VERSION >= 200000 && CLANG_VERSION < 220100)
	select ARCH_HAS_KCOV
	select ARCH_HAS_STRNCPY_FROM_USER
	select ARCH_HAS_STRNLEN_USER
	select ARCH_HAS_STRICT_KERNEL_RWX
	select HAVE_ARCH_AUDITSYSCALL
	select HAVE_ARCH_KASAN if X86_64
	select HAVE_ARCH_KASAN_VMALLOC if HAVE_ARCH_KASAN
	select HAVE_ARCH_KCSAN if X86_64
	select HAVE_ARCH_KFENCE if X86_64
	# KMSAN-on-UML uses the VMALLOC-quarter-split layout. Shadow and
	# origin live inside the VMALLOC range; see
	# arch/um/include/asm/pgtable.h.
	select HAVE_ARCH_KMSAN if X86_64
	select HAVE_ARCH_KMSAN_VMALLOC if HAVE_ARCH_KMSAN
	select HAVE_ARCH_SECCOMP_FILTER
	select HAVE_ASM_MODVERSIONS
	select HAVE_UID16
	select HAVE_DEBUG_KMEMLEAK
	select HAVE_DEBUG_BUGVERBOSE
	select HAVE_PAGE_SIZE_4KB
	select NO_DMA if !UML_DMA_EMULATION
	select OF_EARLY_FLATTREE if OF
	select GENERIC_IRQ_SHOW
	select GENERIC_CPU_DEVICES
	select GENERIC_SMP_IDLE_THREAD
	select HAVE_GCC_PLUGINS
	select ARCH_SUPPORTS_LTO_CLANG
	select ARCH_SUPPORTS_LTO_CLANG_THIN
	select TRACE_IRQFLAGS_SUPPORT
	select TTY # Needed for line.c
	select HAVE_ARCH_VMAP_STACK
	select HAVE_RUST
	select ARCH_HAS_UBSAN
	select HAVE_ARCH_TRACEHOOK
	select HAVE_SYSCALL_TRACEPOINTS
	select HAVE_FUNCTION_TRACER if X86_64
	select HAVE_DYNAMIC_FTRACE if HAVE_FUNCTION_TRACER
	select FTRACE_MCOUNT_USE_PATCHABLE_FUNCTION_ENTRY \
		if DYNAMIC_FTRACE
	# HAVE_FUNCTION_GRAPH_TRACER depends on CC_FLAGS_FTRACE being
	# stripped from arch/um's signal-dispatch + longjmp-entry TUs
	# and on the notrace annotations in arch/um/kernel/signal.c's
	# arch_local_irq_* helpers.
	select HAVE_FUNCTION_GRAPH_TRACER if HAVE_FUNCTION_TRACER
	select HAVE_KPROBES if X86_64
	# HAVE_RETHOOK auto-selects RETHOOK and turns on KRETPROBE_ON_RETHOOK,
	# which is how modern x86_64 supplies KRETPROBES. No need
	# to also select HAVE_KRETPROBES; arch/Kconfig's KRETPROBES depends
	# on (HAVE_KRETPROBES || HAVE_RETHOOK).
	select HAVE_RETHOOK if X86_64
	# BPF JIT. UML
	# consumes arch/x86/net/bpf_jit_comp.c with a handful of
	# UML-local shim headers (asm/vsyscall.h, cpufeature.h's
	# DISABLED_MASK_BIT_SET stub, arch/um/kernel/x86_nops.c)
	# plus a small CONFIG_UM branch in bpf_jit_comp.c's
	# reg2pt_regs[] table. Bare-metal x86 builds are
	# bit-identical past the UML-specific shim points.
	select HAVE_EBPF_JIT if X86_64
	select THREAD_INFO_IN_TASK
	select SPARSE_IRQ
	select MMU_GATHER_RCU_TABLE_FREE

config MMU
	bool
	default y

config UML_DMA_EMULATION
	bool

config NO_IOMEM
	bool "disable IOMEM" if EXPERT
	depends on !INDIRECT_IOMEM
	default y

config UML_IOMEM_EMULATION
	bool
	select INDIRECT_IOMEM
	select GENERIC_PCI_IOMAP

config ISA
	bool

config SBUS
	bool

config LOCKDEP_SUPPORT
	bool
	default y

config STACKTRACE_SUPPORT
	bool
	default y
	select STACKTRACE

config GENERIC_CALIBRATE_DELAY
	bool
	default y

config HZ
	int
	default 100

config UML_SUBARCH_SUPPORTS_SMP
	bool

config SMP
	bool "Symmetric multi-processing support"
	default n
	depends on UML_SUBARCH_SUPPORTS_SMP
	help
	  This option enables UML SMP support.

	  With this enabled, users can tell UML to start multiple virtual
	  processors. Each virtual processor is represented as a separate
	  host thread.

	  In UML, kthreads and normal threads (when running in kernel mode)
	  can be scheduled and executed simultaneously on different virtual
	  processors. However, the userspace code of normal threads still
	  runs within their respective single-threaded stubs.

	  That is, SMP support is available both within the kernel and
	  across different processes, but remains limited within threads
	  of the same process in userspace.

config NR_CPUS_RANGE_BEGIN
	int
	default 1 if !SMP
	default 2

config NR_CPUS_RANGE_END
	int
	default 1 if !SMP
	default 64

config NR_CPUS_DEFAULT
	int
	default 1 if !SMP
	default 2

config NR_CPUS
	int "Maximum number of CPUs" if SMP
	range NR_CPUS_RANGE_BEGIN NR_CPUS_RANGE_END
	default NR_CPUS_DEFAULT

source "arch/$(HEADER_ARCH)/um/Kconfig"

config MAY_HAVE_RUNTIME_DEPS
	bool

config STATIC_LINK
	bool "Force a static link"
	depends on !MAY_HAVE_RUNTIME_DEPS
	help
	  This option gives you the ability to force a static link of UML.
	  Normally, UML is linked as a shared binary.  This is inconvenient for
	  use in a chroot jail.  So, if you intend to run UML inside a chroot,
	  you probably want to say Y here.
	  Additionally, this option enables using higher memory spaces (up to
	  2.75G) for UML.

	  NOTE: This option is incompatible with some networking features which
	  depend on features that require being dynamically loaded (like NSS).

config LD_SCRIPT_STATIC
	bool
	default y
	depends on STATIC_LINK

config LD_SCRIPT_DYN
	bool
	default y
	depends on !LD_SCRIPT_STATIC

config LD_SCRIPT_DYN_RPATH
	bool "set rpath in the binary" if EXPERT
	default y
	depends on LD_SCRIPT_DYN
	help
	  Add /lib (and /lib64 for 64-bit) to the linux binary's rpath
	  explicitly.

	  You may need to turn this off if compiling for nix systems
	  that have their libraries in random /nix directories and
	  might otherwise unexpected use libraries from /lib or /lib64
	  instead of the desired ones.

config HOSTFS
	tristate "Host filesystem"
	help
	  While the User-Mode Linux port uses its own root file system for
	  booting and normal file access, this module lets the UML user
	  access files stored on the host.  It does not require any
	  network connection between the Host and UML.  An example use of
	  this might be:

	  mount none /tmp/fromhost -t hostfs -o /tmp/umlshare

	  where /tmp/fromhost is an empty directory inside UML and
	  /tmp/umlshare is a directory on the host with files the UML user
	  wishes to access.

	  For more information, see
	  <http://user-mode-linux.sourceforge.net/hostfs.html>.

	  If you'd like to be able to work with files stored on the host,
	  say Y or M here; otherwise say N.

config MCONSOLE
	bool "Management console"
	depends on PROC_FS
	default y
	help
	  The user mode linux management console is a low-level interface to
	  the kernel, somewhat like the i386 SysRq interface.  Since there is
	  a full-blown operating system running under every user mode linux
	  instance, there is much greater flexibility possible than with the
	  SysRq mechanism.

	  If you answer 'Y' to this option, to use this feature, you need the
	  mconsole client (called uml_mconsole) which is present in CVS in
	  2.4.5-9um and later (path /tools/mconsole), and is also in the
	  distribution RPM package in 2.4.6 and later.

	  It is safe to say 'Y' here.

config MAGIC_SYSRQ
	bool "Magic SysRq key"
	depends on MCONSOLE
	help
	  If you say Y here, you will have some control over the system even
	  if the system crashes for example during kernel debugging (e.g., you
	  will be able to flush the buffer cache to disk, reboot the system
	  immediately or dump some status information). A key for each of the
	  possible requests is provided.

	  This is the feature normally accomplished by pressing a key
	  while holding SysRq (Alt+PrintScreen).

	  On UML, this is accomplished by sending a "sysrq" command with
	  mconsole, followed by the letter for the requested command.

	  The keys are documented in <file:Documentation/admin-guide/sysrq.rst>. Don't say Y
	  unless you understand the SysRq commands and their effects.

config KERNEL_STACK_ORDER
	int "Kernel stack size order"
	default 2 if 64BIT
	range 2 10 if 64BIT
	default 1 if !64BIT
	help
	  This option determines the size of UML kernel stacks.  They will
	  be 1 << order pages.  The default is OK unless you're running Valgrind
	  on UML, in which case, set this to 3.
	  It is possible to reduce the stack to 1 for 64BIT and 0 for 32BIT on
	  older (pre-2017) CPUs. It is not recommended on newer CPUs due to the
	  increase in the size of the state which needs to be saved when handling
	  signals.

config PGTABLE_LEVELS
	int
	default 4 if 64BIT
	default 2 if !64BIT

config UML_TIME_TRAVEL_SUPPORT
	bool
	prompt "Support time-travel mode (e.g. for test execution)"
	# inf-cpu mode is incompatible with the benchmarking
	depends on !RAID6_PQ_BENCHMARK
	depends on !SMP
	help
	  Enable this option to support time travel inside the UML instance.

	  After enabling this option, two modes are accessible at runtime
	  (selected by the kernel command line), see the kernel's command-
	  line help for more details.

	  It is safe to say Y, but you probably don't need this.

config UML_MAX_USERSPACE_ITERATIONS
	int
	prompt "Maximum number of unscheduled userspace iterations"
	default 10000
	depends on UML_TIME_TRAVEL_SUPPORT
	help
	  In UML inf-cpu and ext time-travel mode userspace can run without being
	  interrupted. This will eventually overwhelm the kernel and create OOM
	  situations (mainly RCU not running). This setting specifies the number
	  of kernel/userspace switches (minor/major page fault, signal or syscall)
	  for the same userspace thread before the sched_clock is advanced by a
	  jiffie to trigger scheduling.

	  Setting it to zero disables the feature.

config KASAN_SHADOW_OFFSET
	hex
	depends on KASAN
	default 0x100000000000
	help
	  This is the offset at which the ~16TB of shadow memory is
	  mapped and used by KASAN for memory debugging. This can be any
	  address that has at least KASAN_SHADOW_SIZE (total address space divided
	  by 8) amount of space so that the KASAN shadow memory does not conflict
	  with anything. The default is 0x100000000000, which works even if mem is
	  set to a large value. On low-memory systems, try 0x7fff8000, as it fits
	  into the immediate of most instructions, improving performance.

# The VMALLOC-quarter-split layout derives KMSAN shadow/origin VAs from
# VMALLOC_START at compile time; no config-tunable base address is
# needed.

#
# Backend selection.
#
# The typed backend ops table lives at arch/um/include/asm/backend.h.
# Two questions, in order:
#   1. Which backend implementations get compiled in?
#   2. How does um_backend_dispatch() resolve?
#
# Invariants:
#   *_ONLY  => exactly one backend compiled in (no other backends)
#   DYNAMIC => at least two backends compiled in
#
# The dispatch-mode choice block enforces this via `select` so the
# user picks intent first and the backend set follows automatically.
#
config UM_BACKEND_SECCOMP
	bool
	depends on HAVE_ARCH_SECCOMP_FILTER
	help
	  Selected by the dispatch mode below. Don't toggle this directly.
	  Compiles arch/um/backend/seccomp/, the normal UML execution
	  backend on hosts with seccomp filter support. The backend runs
	  guest system calls through the SIGSYS/futex trap path instead of
	  ptrace stops, which keeps the common syscall round-trip shorter.

config UM_WORKER_PROCESS
	bool "Per-mm host worker process model"
	default y
	help
	  Spawn one host worker process per guest mm instead of cloning
	  every guest task into the spawner's VA space. The seccomp
	  stub child runs inside the worker; spawner/worker IPC uses
	  a per-worker UNIX socket pair.

	  This is the host-process / threading restructure the v2 KVM
	  backend needs: each guest mm gets a separate host VA space,
	  eliminating cross-mm host-VA collision bugs. seccomp users also
	  benefit from a cleaner host-process boundary.

config UM_WORKER_IPC_SELFTEST_ON_BOOT
	bool "Run worker IPC smoke test on boot"
	depends on UM_WORKER_PROCESS
	default n
	help
	  Run a boot-time self-test for the host worker IPC path. The
	  test spawns a throwaway worker process, drives the four-message
	  round-trip (STUB_ALLOC_REQ -> WRITE_REGS -> RETURN_VALUE ->
	  WRITE_REGS_ACK), verifies that the sentinel value echoes back,
	  and reaps the temporary worker. Boot logs report success or a
	  specific worker IPC error.

	  Useful when developing worker-process changes; gives a
	  one-shot canary that the IPC dispatcher still works without
	  needing to wire the seccomp backend through the worker first.

	  Adds a few hundred milliseconds to boot. Say N for normal
	  development; Y when iterating on worker IPC code.

source "arch/um/backend/kvm-v2/Kconfig"

choice
	prompt "UML backend dispatch mode"
	default UM_BACKEND_DYNAMIC if HAVE_ARCH_SECCOMP_FILTER
	default UM_BACKEND_SECCOMP_ONLY
	help
	  How um_backend_dispatch() resolves and which backends compile.

	  *_ONLY modes inline the dispatch macro to a direct call to the
	  chosen backend; zero indirect-dispatch cost, smallest binary,
	  smallest TCB. Pick this for sandbox / embedded profiles.

	  DYNAMIC compiles every available backend and chooses at boot
	  via the `backend=` kernel command line. One well-predicted
	  indirect call per dispatch site (~5-10 cycles). Pick this for
	  distros and CI matrices that need a single binary to run
	  anywhere.

	  ptrace backend was removed;
	  seccomp-filter has been mainline since 3.5 (2012) and is
	  universal on real hosts. Anyone genuinely without seccomp
	  should pin to a v6.16-or-earlier UML.

config UM_BACKEND_SECCOMP_ONLY
	bool "seccomp backend only (single-backend inline)"
	depends on HAVE_ARCH_SECCOMP_FILTER
	select UM_BACKEND_SECCOMP
	help
	  um_backend_dispatch() expands to direct seccomp_<op>() calls.
	  Smallest binary, zero indirect-dispatch cost. About 3-4x faster
	  syscall path than ptrace via SIGSYS. Requires the host to
	  support seccomp filter installation.

config UM_BACKEND_DYNAMIC
	bool "Dynamic backend selection (seccomp [+ kvm-v2 when ready])"
	depends on HAVE_ARCH_SECCOMP_FILTER
	select UM_BACKEND_SECCOMP
	help
	  seccomp backend compiled in; init_backend() selects it at
	  boot. Default for distros. KVM v2 can be compiled separately
	  and selected explicitly when validation coverage is desired.

endchoice

config UM_BACKEND_CONTRACT_TEST
	tristate "UML backend conformance tests (KUnit)"
	depends on KUNIT
	default n
	help
	  Build the per-op KUnit conformance tests under
	  arch/um/backend/contract/. Each op in struct um_backend_ops gets
	  one test; cross-backend equivalence and perf-regression tests can
	  be added as backend coverage grows.

	  Say N for normal builds; Y or M to validate a backend.

#
# Fuzzer-oriented hooks.
#
# Umbrella Kconfig option for fuzzing-only kernel features. Its job is
# to give the fuzz and fuzz-deep profiles a single toggle that turns on
# snapshot/forkserver, KCOV hot-loop support, and the
# `prctl(PR_SET_CHILD_SUBREAPER)` infrastructure needed to reap
# forkserver workers cleanly at >=1000 iter/s.
#
config UM_FUZZ_HOOKS
	bool "Fuzzer-oriented hooks (forkserver, KCOV hot-loop, reaping)"
	default n
	help
	  Enable fuzzer-oriented kernel features: the snapshot/forkserver
	  hook (CONFIG_UM_SNAPSHOT_FORKSERVER below), KCOV hot-loop support,
	  and reaping refinements. Off by default; enabled by the fuzz and
	  fuzz-deep profile defconfigs.

	  Say N for normal and research builds; Y for fuzz builds.

config UM_SNAPSHOT_FORKSERVER
	bool "Snapshot/forkserver seam"
	depends on UM_FUZZ_HOOKS
	default n
	help
	  Compile arch/um/kernel/snapshot.c: the cooperative in-kernel
	  hook that lets UML quiesce to a known-good "ready point" and
	  fork() itself for each fuzz iteration. Implements the AFL-style
	  forkserver wire protocol on fds 198/199 and binds onto
	  syzkaller's RunSnapshot API.

	  Say N unless you're building a fuzz-profile UML.

config UM_TEMPLATE_PAUSE
	bool "Template-pause + fork hook"
	default n
	help
	  Compile arch/um/kernel/template_pause.c: the cooperative in-
	  kernel hook that lets a booted UML quiesce at a named "ready
	  point," SIGSTOP the host process for an external supervisor
	  (umlctl pool serve) to fork(2), and resume on SIGCONT with a
	  per-child identity blob applied.

	  Two cmdline modes:

	    um_template_pause          - single SIGSTOP /
				          SIGCONT cycle; the master IS
				          the taken instance.
	    um_template_pause=fork     - fork-on-resume loop:
				          each SIGCONT forks the master,
				          the child wakes as the taken
				          instance, the master re-pauses
				          ready for the next take.  Requires
				          CONFIG_UM_TEMPLATE_PAUSE_FORK.

	  No-op (no /proc entry created, no static cost) when the cmdline arg
	  is absent. Safe to set Y in normal and research profiles; the
	  cmdline gates all visible behaviour.

	  Say N unless you intend to use `umlctl pool` or test the
	  template-pause primitive directly.

config UM_TEMPLATE_PAUSE_FORK
	bool "Template-pause fork-on-resume loop"
	depends on UM_TEMPLATE_PAUSE
	select UM_FUZZ_HOOKS
	select UM_SNAPSHOT_FORKSERVER
	default n
	help
	  Fork-on-resume primitive. Master forks on each SIGCONT via
	  __NR_clone with a private MAP_PRIVATE child stack, the child
	  runs on its own stack and exits cleanly via inline
	  __NR_exit_group(0), and master loops back to SIGSTOP for the
	  next take.

	  Refused under the KVM backend at runtime because fork() aliases
	  /dev/kvm fds and per-vCPU mmap state across parent and child.

	  Say N unless you intend to use template-pause fork-on-resume.

config UM_TEMPLATE_PAUSE_IDENTITY_KUNIT
	bool "Template-pause identity-apply KUnit tests"
	depends on UM_TEMPLATE_PAUSE && KUNIT
	default n
	help
	  Build KUnit tests for the parse helpers in
	  arch/um/kernel/template_pause_identity.c (IPv4 CIDR
	  parsing, IPv4 address parsing, prefix-to-netmask conversion).
	  These exercise the pure-C parse path with no net-stack
	  dependencies, so they run cleanly on any UML KUnit kernel.

	  Say N for normal builds; Y when changing or regressing the
	  identity-apply path.

endmenu

source "arch/um/drivers/Kconfig"

config ARCH_SUSPEND_POSSIBLE
	def_bool y
	depends on !SMP

menu "Power management options"

source "kernel/power/Kconfig"

endmenu
```
