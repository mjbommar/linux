## arch/um/drivers/Kconfig
```kconfig
# SPDX-License-Identifier: GPL-2.0

menu "UML Character Devices"

config STDERR_CONSOLE
	bool "stderr console"
	default y
	help
	  console driver which dumps all printk messages to stderr.

config SSL
	bool "Virtual serial line"
	help
	  The User-Mode Linux environment allows you to create virtual serial
	  lines on the UML that are usually made to show up on the host as
	  ttys or ptys.

	  See <http://user-mode-linux.sourceforge.net/old/input.html> for more
	  information and command line examples of how to use this facility.

	  Unless you have a specific reason for disabling this, say Y.

config NULL_CHAN
	bool "null channel support"
	help
	  This option enables support for attaching UML consoles and serial
	  lines to a device similar to /dev/null.  Data written to it disappears
	  and there is never any data to be read.

config PORT_CHAN
	bool "port channel support"
	help
	  This option enables support for attaching UML consoles and serial
	  lines to host portals.  They may be accessed with 'telnet <host>
	  <port number>'.  Any number of consoles and serial lines may be
	  attached to a single portal, although what UML device you get when
	  you telnet to that portal will be unpredictable.
	  It is safe to say 'Y' here.

config PTY_CHAN
	bool "pty channel support"
	help
	  This option enables support for attaching UML consoles and serial
	  lines to host pseudo-terminals.  Access to both traditional
	  pseudo-terminals (/dev/pty*) and pts pseudo-terminals are controlled
	  with this option.  The assignment of UML devices to host devices
	  will be announced in the kernel message log.
	  It is safe to say 'Y' here.

config TTY_CHAN
	bool "tty channel support"
	help
	  This option enables support for attaching UML consoles and serial
	  lines to host terminals.  Access to both virtual consoles
	  (/dev/tty*) and the slave side of pseudo-terminals (/dev/ttyp* and
	  /dev/pts/*) are controlled by this option.
	  It is safe to say 'Y' here.

config XTERM_CHAN
	bool "xterm channel support"
	help
	  This option enables support for attaching UML consoles and serial
	  lines to xterms.  Each UML device so assigned will be brought up in
	  its own xterm.
	  It is safe to say 'Y' here.

config XTERM_CHAN_DEFAULT_EMULATOR
	string "xterm channel default terminal emulator"
	depends on XTERM_CHAN
	default "xterm"
	help
	  This option allows changing the default terminal emulator.

config NOCONFIG_CHAN
	bool
	default !(XTERM_CHAN && TTY_CHAN && PTY_CHAN && PORT_CHAN && NULL_CHAN)

config CON_ZERO_CHAN
	string "Default main console channel initialization"
	default "fd:0,fd:1"
	help
	  This is the string describing the channel to which the main console
	  will be attached by default.  This value can be overridden from the
	  command line.  The default value is "fd:0,fd:1", which attaches the
	  main console to stdin and stdout.
	  It is safe to leave this unchanged.

config CON_CHAN
	string "Default console channel initialization"
	default "xterm"
	help
	  This is the string describing the channel to which all consoles
	  except the main console will be attached by default.  This value can
	  be overridden from the command line.  The default value is "xterm",
	  which brings them up in xterms.
	  It is safe to leave this unchanged, although you may wish to change
	  this if you expect the UML that you build to be run in environments
	  which don't have X or xterm available.

config SSL_CHAN
	string "Default serial line channel initialization"
	default "pty"
	help
	  This is the string describing the channel to which the serial lines
	  will be attached by default.  This value can be overridden from the
	  command line.  The default value is "pty", which attaches them to
	  traditional pseudo-terminals.
	  It is safe to leave this unchanged, although you may wish to change
	  this if you expect the UML that you build to be run in environments
	  which don't have a set of /dev/pty* devices.

config UML_SOUND
	tristate "Sound support"
	depends on SOUND
	select SOUND_OSS_CORE
	help
	  This option enables UML sound support.  If enabled, it will pull in
	  the UML hostaudio relay, which acts as an intermediary
	  between the host's dsp and mixer devices and the UML sound system.
	  It is safe to say 'Y' here.

endmenu

menu "UML Network Devices"
	depends on NET

config UML_NET_VECTOR
	bool "Vector I/O high performance network devices (legacy)"
	select MAY_HAVE_RUNTIME_DEPS
	help
	  Legacy UML vector network driver, superseded by
	  CONFIG_UML_NET_VECTOR_V2 for new deployments.

	  This driver uses multi-message send and receive functions.
	  The host running the UML guest must have a linux kernel
	  version above 3.0 and a libc version > 2.13.  Provides tap,
	  raw, gre and l2tpv3 network transports.

	  Kept for existing deployments and for the remaining raw, gre,
	  and l2tpv3 transports that are not available in vec2.

	  For new deployments, prefer CONFIG_UML_NET_VECTOR_V2.

	  For more information, including explanations of the networking
	  and sample configurations, see
	  <file:Documentation/virt/uml/user_mode_linux_howto_v2.rst>.

config UML_NET_VECTOR_V2
	bool "Vector networking v2"
	select UML_NET_VECTOR_V2_CONFIG
	select UML_NET_VECTOR_V2_MODEL
	select UML_NET_VECTOR_V2_QUEUE
	default n
	help
	  Build the UML vector networking v2 runtime: typed command-line
	  parsing, explicit queue ownership, host backends, and netdev
	  integration for vec2 devices.

	  Say Y to enable vec2 devices. Say N to use the existing vector
	  driver only.

config UML_NET_VECTOR_V2_INPROC
	bool "Permit vector networking v2 trusted in-process host operations"
	depends on UML_NET_VECTOR_V2
	default n
	help
	  Permit vector v2 runtime parsing to accept options that require the
	  UML process to directly consume host networking authority, such as
	  TAP interface names, helper scripts, direct host fd numbers, and BPF
	  file paths. This mode is only appropriate when the UML process
	  is trusted with those host resources.

	  Say N for sandboxed UML v2 execution.

config UML_NET_VECTOR_V2_SANDBOX
	bool
	depends on UML_NET_VECTOR_V2
	default y if !UML_NET_VECTOR_V2_INPROC

config UML_NET_VECTOR_V2_CONFIG
	bool

config UML_NET_VECTOR_V2_QUEUE
	bool

config UML_NET_VECTOR_V2_FAKE_HOST
	bool
	select UML_NET_VECTOR_V2_QUEUE

config UML_NET_VECTOR_V2_TRANSPORT
	bool

config UML_NET_VECTOR_V2_MODEL
	bool

config UML_NET_VECTOR_V2_KUNIT
	bool "Vector networking v2 config parser KUnit tests"
	depends on KUNIT
	select UML_NET_VECTOR_V2_CONFIG
	default n
	help
	  Build KUnit tests for the typed configuration parser used by
	  vector networking v2. These tests validate parser behavior and
	  policy checks without host networking resources.

	  Say N for normal builds. Say Y to run the parser tests.

config UML_NET_VECTOR_V2_QUEUE_KUNIT
	bool "Vector networking v2 queue ownership KUnit tests"
	depends on KUNIT
	select UML_NET_VECTOR_V2_QUEUE
	default n
	help
	  Build KUnit tests for the explicit TX ring and RX batch ownership
	  helpers used by vector networking v2.
	  These tests validate wraparound, partial completion, RX prepare
	  and consume ordering, and failure unwind without changing the
	  vector networking data path.

	  Say N for normal builds. Say Y to run the queue tests.

config UML_NET_VECTOR_V2_TRANSPORT_KUNIT
	bool "Vector networking v2 transport header KUnit tests"
	depends on KUNIT
	select UML_NET_VECTOR_V2_TRANSPORT
	default n
	help
	  Build KUnit tests for bounds-checked GRE and L2TPv3 header build
	  and parse helpers used by vector networking v2. These tests
	  validate that short buffers and mismatched transport identifiers
	  fail closed without touching the existing
	  vector network data path.

	  Say N for normal builds. Say Y to run the transport tests.

config UML_NET_VECTOR_V2_FAKE_HOST_KUNIT
	bool "Vector networking v2 fake host KUnit tests"
	depends on KUNIT
	select UML_NET_VECTOR_V2_FAKE_HOST
	default n
	help
	  Build KUnit tests for the host-ops boundary and deterministic fake
	  host used by vector networking v2. These
	  tests exercise partial TX completion, transient host errors, empty
	  RX, RX allocation unwind, and fd death without using host network
	  resources.

	  Say N for normal builds. Say Y to run the fake-host tests.

config UML_NET_VECTOR_V2_MODEL_KUNIT
	bool "Vector networking v2 state model KUnit tests"
	depends on KUNIT
	select UML_NET_VECTOR_V2_MODEL
	default n
	help
	  Build KUnit tests for the explicit device and channel lifecycle
	  state machines used by vector networking v2. These tests validate
	  legal transitions and failure unwind paths.

	  Say N for normal builds. Say Y to run the state-model tests.

config UML_NET_VECTOR_V2_CMDLINE_KUNIT
	bool "Vector networking v2 command-line KUnit tests"
	depends on KUNIT
	select UML_NET_VECTOR_V2
	default n
	help
	  Build KUnit tests for the vector v2 runtime command-line splitter.
	  These tests validate the distinct vec2 syntax, option grouping,
	  empty argument handling, malformed input rejection, and legacy
	  vector syntax isolation. They do not create a host network device or
	  run the vector data path.

	  Say N for normal builds. Say Y to run the command-line tests.

config UML_NET_VECTOR_V2_NETDEV_KUNIT
	bool "Vector networking v2 netdev KUnit tests"
	depends on KUNIT
	select UML_NET_VECTOR_V2
	select UML_NET_VECTOR_V2_FAKE_HOST
	default n
	help
	  Build KUnit tests for the vector v2 netdev integration. These
	  tests validate stable device naming, lifecycle unwind for
	  backend-missing open, stopped-state stop handling, xmit safety,
	  configured queue counts, the deterministic queue-to-CPU policy
	  used for XPS setup, and the NAPI poll path branches (healthy
	  round, backend-dead, tx-more rescheduling, rx alloc error,
	  rx protocol drop) driven via the deterministic fake host.

	  Say N for normal builds. Say Y to run the netdev tests.

config UML_NET_VECTOR_V2_ETHTOOL_KUNIT
	bool "Vector networking v2 ethtool KUnit tests"
	depends on KUNIT
	select UML_NET_VECTOR_V2
	select UML_NET_VECTOR_V2_FAKE_HOST
	default n
	help
	  Build KUnit tests for the vector v2 ethtool surface. These tests
	  validate stopped-state stats, ring depth policy, counter export,
	  and ethtool stats-read while traffic is in flight (spin_lock_bh
	  contention against the fake host backend).

	  Say N for normal builds. Say Y to run the ethtool tests.

config UML_NET_VECTOR_V2_HOST_FD_KUNIT
	bool "Vector networking v2 fd host KUnit tests"
	depends on KUNIT
	select UML_NET_VECTOR_V2
	default n
	help
	  Build KUnit tests for the vector v2 fd host backend. These tests
	  validate direct-fd duplication, close unwind, bad-fd failure
	  behavior, netdev open/stop lifecycle integration, and raw-frame
	  TX/RX over supplied fds, including contiguous-fd multiqueue open
	  and failure unwind.

	  Say N for normal builds. Say Y to run the fd-host tests.

config UML_NET_VECTOR_V2_HOST_TAP_KUNIT
	bool "Vector networking v2 TAP host KUnit tests"
	depends on KUNIT
	select UML_NET_VECTOR_V2
	default n
	help
	  Build KUnit tests for the vector v2 trusted TAP host backend.
	  These tests validate fd ownership, close unwind, and sandbox
	  fail-closed behavior without requiring a real host TAP device.

	  Say N for normal builds. Say Y to run the TAP-host tests.

endmenu

config VIRTIO_UML
	bool "UML driver for virtio devices"
	select VIRTIO
	help
	  This driver provides support for virtio based paravirtual device
	  drivers over vhost-user sockets.

config UML_RTC
	bool "UML RTC driver"
	depends on RTC_CLASS
	# there's no use in this if PM_SLEEP isn't enabled ...
	depends on PM_SLEEP
	help
	  When PM_SLEEP is configured, it may be desirable to wake up using
	  rtcwake, especially in time-travel mode. This driver enables that
	  by providing a fake RTC clock that causes a wakeup at the right
	  time.

config UML_PCI
	bool
	select FORCE_PCI
	select IRQ_MSI_LIB
	select UML_IOMEM_EMULATION
	select UML_DMA_EMULATION
	select PCI_MSI
	select PCI_LOCKLESS_CONFIG

config UML_PCI_OVER_VIRTIO
	bool "Enable PCI over VIRTIO device simulation"
	# VIRTIO alone would recurse through this dependency.
	depends on VIRTIO_UML
	select UML_PCI

config UML_PCI_OVER_VIRTIO_DEVICE_ID
	int "set the virtio device ID for PCI emulation"
	default -1
	depends on UML_PCI_OVER_VIRTIO
	help
	  There's no official device ID assigned (yet), set the one you
	  wish to use for experimentation here. The default of -1 is
	  not valid and will cause the driver to fail at probe.

config UML_PCI_OVER_VFIO
	bool "Enable VFIO-based PCI passthrough"
	select UML_PCI
	help
	  This driver provides support for VFIO-based PCI passthrough.
	  Currently, only MSI-X capable devices are supported, and it
	  is assumed that drivers will use MSI-X.
```
