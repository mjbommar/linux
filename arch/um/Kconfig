## arch/um/backend/kvm-v2/Kconfig
```kconfig
config UM_BACKEND_KVM_V2
	bool "KVM backend v2"
	depends on X86_64
	default n
	help
	  Build the UML KVM backend v2 alongside the existing seccomp
	  backend. KVM v2 uses a per-host-CPU vCPU pool, a
	  KVM_SET_USER_MEMORY_REGION memslot covering uml_physmem, and the
	  standard x86_64 UML memory layout.

	  Boot uses seccomp via DYNAMIC unless `backend=force=kvm-v2`
	  explicitly picks v2. Selecting Y here builds v2's machinery
	  alongside seccomp; the runtime backend is still chosen by
	  cmdline / capability probe.

	  Say Y to build v2 alongside seccomp. Runtime selection still
	  happens through the backend command-line selector.

config UM_BACKEND_KVM_V2_GADGET
	bool "Stay-in-guest LSTAR gadget for trivial syscalls"
	depends on UM_BACKEND_KVM_V2
	default y
	help
	  In-LSTAR dispatch tree that handles trivial syscalls (getpid,
	  gettid, getppid, getuid, geteuid, getgid,
	  getegid, getcpu, time, clock_gettime(CLOCK_MONOTONIC)) entirely
	  in-guest by reading per-task fields via swapgs + %gs:OFFSET. Avoids
	  the host-side KVM_EXIT_IO roundtrip for those syscalls.

	  This reduces syscall overhead for workloads dominated by cheap
	  syscalls. Workload-level speedup is proportional to gadget-syscall
	  density.

	  Mechanism: the LSTAR target is a small trampoline page mapped
	  in the kernel-half VA range. On guest SYSCALL the CPU jumps there
	  at CPL=0; the body decodes RAX (NR), reads task state from a
	  per-vCPU state page (programmed via MSR_KERNEL_GS_BASE), and
	  returns via SYSRETQ; no vmexit. Any non-gadget NR falls through
	  to the same out+sysretq fallback path that the non-gadget v2
	  backend uses, routed through KVM_EXIT_IO -> handle_io_trap ->
	  handle_syscall.

	  Selecting N disables the gadget at compile time:
	    - trampoline_install writes only the 5-byte fallback LSTAR
	    - per-vCPU state pages are not allocated
	    - load_user_sregs skips the per-dispatch field refresh
	    - MSR_KERNEL_GS_BASE is not programmed

	  The result is a backend where every SYSCALL takes the KVM_EXIT_IO
	  path.

	  Say N for security-sensitive deployments that don't want a custom
	  CPL=0 trampoline body executing in the guest. Say Y (default) to
	  enable the lower-overhead syscall path.

config UM_BACKEND_KVM_V2_KUNIT
	tristate "KVM v2 backend KUnit tests"
	depends on UM_BACKEND_KVM_V2 && KUNIT
	default n
	help
	  Build the v2 backend KUnit suites. These are pure data-transform
	  and byte-layout tests.
	  Catches off-by-one register slot mappings + RFLAGS-bit-1
	  invariants in kvm_v2_marshal_to/from_kvm_regs.

	  Say N for normal builds; Y or M to run the v2 backend
	  KUnit suites.

config UM_BACKEND_KVM_V2_RECORD_REPLAY_EXPERIMENTAL
	bool "Experimental KVM v2 record/replay core"
	depends on UM_BACKEND_KVM_V2
	default n
	help
	  Build the KVM v2 record/replay container and its syscall-log
	  encoder/decoder. The core provides a single active record session,
	  a bounded in-memory event stream, strict replay checking, and KUnit
	  coverage for the state machine and FIFO replay rules.

	  This does not yet expose a supported user ABI or wire full
	  deterministic runtime replay into the live syscall, time, signal, or
	  device paths. Keep this off for normal builds while the remaining
	  record/replay integration is completed.

config UM_BACKEND_KVM_V2_RECORD_REPLAY_KUNIT
	tristate
	depends on UM_BACKEND_KVM_V2_RECORD_REPLAY_EXPERIMENTAL
	depends on UM_BACKEND_KVM_V2_KUNIT
	default UM_BACKEND_KVM_V2_KUNIT

config UM_BACKEND_KVM_V2_RDPMC
	bool "Allow guest userspace rdpmc (CR4.PCE=1)"
	depends on UM_BACKEND_KVM_V2
	default y
	help
	  Set CR4.PCE=1 in the guest's per-vCPU control registers so
	  userspace can execute `rdpmc` directly without #GP at CPL=3.
	  Without this, rdpmc is privileged (PMC accessible only to
	  guest CPL=0 code; for UML that means the LSTAR gadget and
	  exception stubs, neither of which uses rdpmc).

	  This enables:
	    - Userspace `perf` inside the guest gets accurate hardware
	      counter reads (instructions retired, cycles, branches,
	      cache misses, ...) directly via rdpmc.  No gadget syscall
	      round-trip, no IPC, just a one-instruction read.
	    - Profile-guided JITs (PyPy, JS engines) and microbenchmark
	      harnesses can self-measure inside the UML guest.
	    - The example at
	      Documentation/virt/uml/examples/rdpmc/ demonstrates the
	      pattern (read PMC fixed-counter 0 = instructions retired,
	      assert it advances across a busy loop).

	  This does not enable:
	    - rdmsr / wrmsr on PMU MSRs: those stay privileged. The
	      guest cannot program PERFEVTSEL counters from userspace
	      (counter selection is a kernel-only operation under
	      Linux's perf subsystem; gated behind the perf_event
	      syscall).
	    - Specific PMU event allowlist control: that's a separate
	      KVM cap (KVM_CAP_PMU_EVENT_FILTER) not exposed here.
	    - Crossing the host/guest counter-attribution boundary in
	      any new way.  KVM's vPMU already virtualizes counters
	      per-vCPU; CR4.PCE just changes the CPL gate on rdpmc.

	  Cost: a single bit set in the sregs install path; zero
	  runtime overhead.

	  Security: rdpmc returns counter values for the running vCPU.
	  In SMP UML with vCPU pinning those values reflect the host CPU
	  the vCPU is bound to. Treating them as a side
	  channel against other guests on the same physical CPU is a
	  known concern for any KVM userspace -- gate this OFF for
	  multi-tenant sandbox profiles.

	  Say Y for test and observability builds. Say N for sandbox profiles
	  that explicitly want rdpmc unavailable.

config UM_BACKEND_KVM_V2_APERFMPERF_PASSTHROUGH
	bool "Pass APERF/MPERF MSRs through to guest (host-counter visibility)"
	depends on UM_BACKEND_KVM_V2
	default n
	help
	  Enable KVM_CAP_X86_DISABLE_EXITS with the
	  KVM_X86_DISABLE_EXITS_APERFMPERF bit during VM creation so the
	  guest can read IA32_APERF (0xE7) and IA32_MPERF (0xE8) directly
	  via rdmsr. Without this, KVM traps the read and returns zero;
	  with it, the rdmsr passes through to hardware and the guest sees
	  the actual host performance counters for the CPU the vCPU is
	  pinned to.

	  Useful for:
	    - Guest-side frequency / utilization observation
	      (cpupower, turbostat, perf governors)
	    - Testing APERF/MPERF passthrough behavior that is not exposed
	      by every userspace VMM
	    - Anyone studying how the disable-exits surface behaves under
	      a non-QEMU userspace

	  Host requirements:
	    - boot_cpu_has(X86_FEATURE_APERFMPERF) must be set; KVM's
	      kvm_get_allowed_disable_exits() gates the bit on that.
	      If the host rejects the cap, vm_create logs a warning and
	      leaves KVM's default zero-counter behavior in place.

	  Constraints:
	    - The ioctl is issued from kvm_v2_vm_create(), strictly
	      before kvm_v2_vcpu_create().  KVM's KVM_CAP_X86_DISABLE_EXITS
	      handler enforces `if (kvm->created_vcpus) return -EINVAL;`
	      so the ordering must not slip.
	    - Bit is per-VM; in v2 there is one VM per UML invocation, so
	      this is also a per-instance toggle.

	  Runtime override:
	    Boot param  kvm_v2_aperfmperf=on   forces enable
	                kvm_v2_aperfmperf=off  forces disable
	    overriding the Kconfig default.  The override only takes
	    effect when CONFIG_UM_BACKEND_KVM_V2_APERFMPERF_PASSTHROUGH=y
	    (the cmdline parser is gated on the same symbol).

	  See Documentation/virt/uml/aperf-mperf.rst for the in-guest
	  rdmsr verification path.

	  Say N for normal builds. Say Y when testing APERF/MPERF
	  disable-exits or doing host-counter-visible workloads.

config UM_BACKEND_KVM_V2_ITIMER_VIRTUAL
	bool "Account host KVM_RUN CPU time as guest utime (ITIMER_VIRTUAL)"
	depends on UM_BACKEND_KVM_V2
	default y
	help
	  Account TSC-cycle delta around each ioctl(KVM_RUN) to the
	  calling task's utime via account_user_time().  Without this,
	  host timer signals interrupting KVM_RUN default to is_user=0
	  (system time). Without this accounting, guest utime never advances
	  and ITIMER_VIRTUAL never delivers SIGVTALRM.

	  Cost: ~30 cycles per KVM_RUN dispatch (two rdtsc reads +
	  mult_frac conversion). Negligible vs the original
	  clock_gettime-based approach which added ~25% bench-py overhead on
	  Python startup. Default y because the cost is small enough not to
	  need an opt-in.

	  Say N only if you specifically need to disable guest utime
	  accounting (rare).  setitimer(ITIMER_VIRTUAL) will arm but
	  never fire when N.
```
